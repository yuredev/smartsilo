/*
 * esp2io.ino generated by FirmataBuilder
 * Thu Jun 11 2020 18:44:36 GMT-0400 (EDT)
 * Modified by Josenalde Oliveira - June 2020
 */

#include <ConfigurableFirmata.h>

//#include <DigitalInputFirmata.h>
//DigitalInputFirmata digitalInput;
//
//#include <DigitalOutputFirmata.h>
//DigitalOutputFirmata digitalOutput;

#include <AnalogInputFirmata.h>
AnalogInputFirmata analogInput;

//#include <AnalogOutputFirmata.h>
//AnalogOutputFirmata analogOutput;

#include <FirmataExt.h>
FirmataExt firmataExt;

//#include <AnalogWrite.h>

//#include <FirmataReporting.h>
//irmataReporting reporting;

void sysexCallback(byte, byte, byte*);
void systemResetCallback();

void initTransport()
{
  // Uncomment to save a couple of seconds by disabling the startup blink sequence.
  // Firmata.disableBlinkVersion();
  Firmata.begin(57600);
}

void initFirmata()
{
  Firmata.setFirmwareVersion(FIRMATA_FIRMWARE_MAJOR_VERSION, FIRMATA_FIRMWARE_MINOR_VERSION);

//  firmataExt.addFeature(digitalInput);
//  firmataExt.addFeature(digitalOutput);
  firmataExt.addFeature(analogInput);
//  firmataExt.addFeature(analogOutput); unnecessary
//  firmataExt.addFeature(reporting);
//  
  Firmata.attach(SYSTEM_RESET, systemResetCallback);
  Firmata.attach(START_SYSEX, sysexCallback);
}

void setup()
{
  initFirmata();

  initTransport();
  // with these lines the framework does not respond! posted in 11.06.2020
  //Firmata.parse(SYSTEM_RESET);
  //Firmata.parse(START_SYSEX);

  analogReadResolution(12);
  // if you want to directly test specific esp-32 pins (without framework)
  //pinMode(2, OUTPUT);
  
}

void loop()
{
  //digitalInput.report();

  while(Firmata.available()) {
    Firmata.processInput();
  }

  //if (reporting.elapsed()) {
  //  analogInput.report();
  //}

  #ifdef FIRMATA_SERIAL_FEATURE
    serialFeature.update();
  #endif
}

void systemResetCallback()
{
  for (byte i = 0; i < TOTAL_PINS; i++) {
    if (IS_PIN_ANALOG(i)) {
      Firmata.setPinMode(i, ANALOG);
    } else if (IS_PIN_DIGITAL(i)) {
      Firmata.setPinMode(i, OUTPUT);
    }
  }
  firmataExt.reset();
}

/*==============================================================================
 * SYSEX-BASED commands
 *============================================================================*/

void sysexCallback(byte command, byte argc, byte *argv)
{

// test if the callback is being called from framework
  //digitalWrite(2, HIGH);
  //delay(5000);
  //digitalWrite(2, LOW);
  firmataExt.handleSysex(command, argc, argv);
  
  
}
